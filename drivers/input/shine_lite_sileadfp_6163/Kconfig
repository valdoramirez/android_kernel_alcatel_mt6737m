## drivers/input/shine_lite_sileadfp_6163/Kconfig
```kconfig
config FINGERPRINT_GSL6163
  bool FINGERPRINT_GSL6163
  default n
  help
    silead fingerprint driver
```

## drivers/misc/mediatek/accelerometer/mxc400x/Kconfig
```kconfig
config MTK_MXC400X
	bool "MTK_MXC400X for MediaTek package"
	default n
	help
	  It support different accelerometer sensor.
          If this option is set,
	  it will support
          MTK_MXC400X Accelerometer.

config MXC400X_LOWPASS 
	bool "MTK_MXC400X_LOWPASS for Mediatek package"
	default n
	help
	Say Y here if you have MTK_MXC400X touch panel MXC400X_LOWPASS.

	If unsure, say N.

	To compile this dirver as a module, choose M here: the
	module will be called.

config CUSTOM_KERNEL_SENSORHUB
	bool "MTK_MXC400X for Mediatek package"
	default n
	help
	Say Y here if you have MTK_MXC400X touch panel CUSTOM_KERNEL_SENSORHUB.

	If unsure, say N.

	To compile this dirver as a module, choose M here: the
	module will be called.
```

## drivers/misc/mediatek/accelerometer/shine4g_bma255-new/Kconfig
```kconfig
config MTK_SHINE4G_BMA255_NEW
	bool "MTK_SHINE4G_BMA255_NEW for MediaTek package"
	default n
	help
	  It support different accelerometer sensor.
          If this option is set,
	  it will support
          MTK_SHINE4G_BMA255_NEW Accelerometer.
```

## drivers/misc/mediatek/accelerometer/shine_lite-n2dm/Kconfig
```kconfig
config MTK_SHINE_LITE_N2DM_NEW
	bool "MTK_SHINE_LITE_LIS3DH_NEW for MediaTek package"
	default n
	
```

## drivers/misc/mediatek/accelerometer/shine_lite_bma255-new/Kconfig
```kconfig
config MTK_SHINE_LITE_BMA255_NEW
	bool "MTK_SHINE_LITE_BMA255_NEW for MediaTek package"
	default n
	help
	  It support different accelerometer sensor.
          If this option is set,
	  it will support
          MTK_SHINE_LITE_BMA255_NEW Accelerometer.
```

## drivers/misc/mediatek/accelerometer/shine_lite_kxtj2-1009/Kconfig
```kconfig
config MTK_SHINE_LITE_KXTJ2_1009
	bool "MTK_SHINE_LITE_KXTJ2_1009 for MediaTek package"
	default n
	help
	  It support different accelerometer sensor.
          If this option is set,
	  it will support
          MTK_SHINE_LITE_KXTJ2_1009 Accelerometer.
```

## drivers/misc/mediatek/accelerometer/shine_lite_mc3413-p/Kconfig
```kconfig
config MTK_SHINE_LITE_MC3413_P
	bool "MTK_SHINE_LITE_MC3413_P for MediaTek package"
	default n
	help
	  It support different accelerometer sensor.
          If this option is set,
	  it will support
          MTK_SHINE_LITE_MC3413_P Accelerometer.
```

## drivers/misc/mediatek/alsps/ctp_alsps/Kconfig
```kconfig
config MTK_CTP_ALSPS
	bool "MTK_CTP_ALSPSS for MediaTek package"
	default n
	help
	It support different type sensor
	in this platform. If this option
	is set, it will support MTK_CTP_ALSPS.
```

## drivers/misc/mediatek/alsps/ps_tp/Kconfig
```kconfig
config MTK_PS_TP
	bool "ps_tp for MediaTek package"
	default n
	help
	It support simulator psensor
```

## drivers/misc/mediatek/alsps/shine_lite_rpr0521/Kconfig
```kconfig
config MTK_SHINE_LITE_RPR0521
    bool "rpr0521 for MediaTek package"
    default n
```

## drivers/misc/mediatek/gyroscope/Kconfig
```kconfig
config CUSTOM_KERNEL_GYROSCOPE
	bool "CUSTOM_KERNEL_GYROSCOPE"
	help
	  gyroscope sensor to detect gyroscope from x y z axis.
          If the platform is supported for gyroscope, this
          configuration should be configured, and the gyroscope
          driver configuration should be configured as well.

source "drivers/misc/mediatek/gyroscope/ITG1010-new/Kconfig"
source "drivers/misc/mediatek/gyroscope/mpu6050gy-new/Kconfig"
source "drivers/misc/mediatek/gyroscope/mpu6515/Kconfig"
source "drivers/misc/mediatek/gyroscope/icm20645gy/Kconfig"
# begin: add by binpeng.huang.hz@tcl.com on 2016.08.05 for BMG250
source "drivers/misc/mediatek/gyroscope/bmi160/Kconfig"
# # end: add by binpeng.huang.hz@tcl.com on 2016.08.05 for BMG250
```

## drivers/misc/mediatek/gyroscope/bmi160/Kconfig
```kconfig
config MTK_BMI160
        bool "BMI160 for MediaTek package"
        default n
        help
        It support different gyroscope sensor.
        If this option is set,
	  	it will support
         BMI160 gyroscope.
```

## drivers/misc/mediatek/hifi/Kconfig
```kconfig
config MTK_HIFI
    bool "MTK_HIFI"
    default n
    help
        If you say Y, enable MTK_EXT_CODEC. 
    
#choice
config MTK_HIFI_CHIP_AK4376
	bool "AKM ak4376 hifi"
	default n
	depends on MTK_HIFI
	
config MTK_HIFI_CHIP_AK4375
    bool "AKM ak4375 hifi"
    default n
    depends on MTK_HIFI
#endchoice
```

## drivers/misc/mediatek/magnetometer/shine4g_bmm150-new/Kconfig
```kconfig
config MTK_SHINE4G_BMM150_NEW
	bool "MTK_SHINE4G_BMM150_NEW for MediaTek package"
	default n
	help
	  It support different magnetometer sensor.
          If this option is set,
	  it will support
          MTK_SHINE4G_BMM150_NEW magnetometer.
```

## drivers/misc/mediatek/robust/Kconfig
```kconfig
config TCT_ROBUST
	bool "CONFIG_TCT_ROBUST for MediaTek package"
	default n
	help
	It support different type sensor
	in this platform. If this option
	is set, it will support ROBUST.
```
