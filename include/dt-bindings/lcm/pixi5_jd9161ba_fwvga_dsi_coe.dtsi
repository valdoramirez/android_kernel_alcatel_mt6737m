
#include "lcm_define.h"

/ {
	/* LCM standardization */
	lcm_params@5{
		compatible = "mediatek,lcm_params-pixi5_jd9161ba_fwvga_dsi_coe";

		lcm_params-types = <2 0 0 0>;
		/* type, ctrl, lcm_if, lcm_cmd_if */
		lcm_params-resolution = <480 854>;
		/* width, height */
		lcm_params-io_select_mode;

		lcm_params-dbi-port;
		lcm_params-dbi-clock_freq;
		lcm_params-dbi-data_width;
		lcm_params-dbi-data_format;
		/* color_order, trans_seq, padding, format, width */
		lcm_params-dbi-cpu_write_bits;
		lcm_params-dbi-io_driving_current;
		lcm_params-dbi-msb_io_driving_current;
		lcm_params-dbi-ctrl_io_driving_current;

		lcm_params-dbi-te_mode = <0>;
		lcm_params-dbi-te_edge_polarity;
		lcm_params-dbi-te_hs_delay_cnt;
		lcm_params-dbi-te_vs_width_cnt;
		lcm_params-dbi-te_vs_width_cnt_div;

		lcm_params-dbi-serial-params0;
		/* cs_polarity, clk_polarity, clk_phase, is_non_dbi_mode, clock_base, clock_div */
		lcm_params-dbi-serial-params1;
		/* css, csh, rd_1st, rd_2nd, wr_1st, wr_2nd */
		lcm_params-dbi-serial-params2;
		/* sif_1st_pol, sif_sck_def, sif_3wire, sif_sdi sif_div2, sif_hw_cs */
		lcm_params-dbi-parallel-params0;
		/* write_setup, write_hold, write_wait, read_setup */
		lcm_params-dbi-parallel-params1;
		/* read_hold, read_latency, wait_period, cs_high_width */

		lcm_params-dpi-mipi_pll_clk_ref;
		lcm_params-dpi-mipi_pll_clk_div1;
		lcm_params-dpi-mipi_pll_clk_div2;
		lcm_params-dpi-mipi_pll_clk_fbk_div;

		lcm_params-dpi-dpi_clk_div;
		lcm_params-dpi-dpi_clk_duty;
		lcm_params-dpi-PLL_CLOCK;
		lcm_params-dpi-dpi_clock;
		lcm_params-dpi-ssc_disable;
		lcm_params-dpi-ssc_range;

		lcm_params-dpi-width;
		lcm_params-dpi-height;
		lcm_params-dpi-bg_width;
		lcm_params-dpi-bg_height;

		lcm_params-dpi-clk_pol;
		lcm_params-dpi-de_pol;
		lcm_params-dpi-vsync_pol;
		lcm_params-dpi-hsync_pol;
		lcm_params-dpi-hsync_pulse_width;
		lcm_params-dpi-hsync_back_porch;
		lcm_params-dpi-hsync_front_porch;
		lcm_params-dpi-vsync_pulse_width;
		lcm_params-dpi-vsync_back_porch;
		lcm_params-dpi-vsync_front_porch;

		lcm_params-dpi-format;
		lcm_params-dpi-rgb_order;
		lcm_params-dpi-is_serial_output;
		lcm_params-dpi-i2x_en;
		lcm_params-dpi-i2x_edge;
		lcm_params-dpi-embsync;
		lcm_params-dpi-lvds_tx_en;
		lcm_params-dpi-bit_swap;
		lcm_params-dpi-intermediat_buffer_num;
		lcm_params-dpi-io_driving_current;
		lcm_params-dpi-lsb_io_driving_current;

		lcm_params-dsi-mode = <1>;
		lcm_params-dsi-switch_mode;
		lcm_params-dsi-DSI_WMEM_CONTI;
		lcm_params-dsi-DSI_RMEM_CONTI;
		lcm_params-dsi-VC_NUM;
		lcm_params-dsi-lane_num = <2>;
		lcm_params-dsi-data_format = <0 0 0 2>;
		/* color_order, trans_seq, padding, format */
		lcm_params-dsi-intermediat_buffer_num = <2>;
		lcm_params-dsi-ps = <2>;
		lcm_params-dsi-word_count = <1440>;
		lcm_params-dsi-packet_size = <256>;

		lcm_params-dsi-vertical_sync_active = <2>;
		lcm_params-dsi-vertical_backporch = <8>;
		lcm_params-dsi-vertical_frontporch = <21>;
		lcm_params-dsi-vertical_frontporch_for_low_power;
		lcm_params-dsi-vertical_active_line = <854>;
		lcm_params-dsi-horizontal_sync_active = <4>;
		lcm_params-dsi-horizontal_backporch = <80>;
		lcm_params-dsi-horizontal_frontporch = <100>;
		lcm_params-dsi-horizontal_blanking_pixel;
		lcm_params-dsi-horizontal_active_pixel = <480>;
		lcm_params-dsi-horizontal_bllp;
		lcm_params-dsi-line_byte;
		lcm_params-dsi-horizontal_sync_active_byte;
		lcm_params-dsi-horizontal_backportch_byte;
		lcm_params-dsi-horizontal_frontporch_byte;
		lcm_params-dsi-rgb_byte;
		lcm_params-dsi-horizontal_sync_active_word_count;
		lcm_params-dsi-horizontal_backporch_word_count;
		lcm_params-dsi-horizontal_frontporch_word_count;

		lcm_params-dsi-HS_TRAIL = <7>;
		lcm_params-dsi-ZERO;
		lcm_params-dsi-HS_PRPR = <4>;
		lcm_params-dsi-LPX;
		lcm_params-dsi-TA_SACK;
		lcm_params-dsi-TA_GET;
		lcm_params-dsi-TA_SURE;
		lcm_params-dsi-TA_GO;
		lcm_params-dsi-CLK_TRAIL = <50>;
		lcm_params-dsi-CLK_ZERO;
		lcm_params-dsi-LPX_WAIT;
		lcm_params-dsi-CONT_DET;
		lcm_params-dsi-CLK_HS_PRPR;
		lcm_params-dsi-CLK_HS_POST;
		lcm_params-dsi-DA_HS_EXIT;
		lcm_params-dsi-CLK_HS_EXIT;

		lcm_params-dsi-pll_select;
		lcm_params-dsi-pll_div1;
		lcm_params-dsi-pll_div2;
		lcm_params-dsi-fbk_div;
		lcm_params-dsi-fbk_sel;
		lcm_params-dsi-rg_bir;
		lcm_params-dsi-rg_bic;
		lcm_params-dsi-rg_bp;
		lcm_params-dsi-pll_clock = <234>;
		lcm_params-dsi-dsi_clock;
		lcm_params-dsi-ssc_disable;
		lcm_params-dsi-ssc_range;
		lcm_params-dsi-compatibility_for_nvk;
		lcm_params-dsi-cont_clock;

		lcm_params-dsi-ufoe_enable;
		lcm_params-dsi-ufoe_params;
		/* compress_ratio, lr_mode_en, vlc_disable, vlc_config */
		lcm_params-dsi-edp_panel;

		lcm_params-dsi-customization_esd_check_enable;
		lcm_params-dsi-esd_check_enable;

		lcm_params-dsi-lcm_int_te_monitor;
		lcm_params-dsi-lcm_int_te_period;
		lcm_params-dsi-lcm_ext_te_monitor;
		lcm_params-dsi-lcm_ext_te_enable;

		lcm_params-dsi-noncont_clock;
		lcm_params-dsi-noncont_clock_period;
		lcm_params-dsi-clk_lp_per_line_enable;

		lcm_params-dsi-lcm_esd_check_table0;
		/* cmd, count, para_list[0], para_list[1] */
		lcm_params-dsi-lcm_esd_check_table1;
		lcm_params-dsi-lcm_esd_check_table2;

		lcm_params-dsi-switch_mode_enable;
		lcm_params-dsi-dual_dsi_type;
		lcm_params-dsi-lane_swap_en;
		lcm_params-dsi-lane_swap0;
		/* lane_swap[0][0~5] */
		lcm_params-dsi-lane_swap1;
		/* lane_swap[1][0~5] */
		lcm_params-dsi-vertical_vfp_lp;
		lcm_params-physical_width;
		lcm_params-physical_height;
		lcm_params-od_table_size;
		lcm_params-od_table;
	};

	lcm_ops@5{
		compatible = "mediatek,lcm_ops-pixi5_jd9161ba_fwvga_dsi_coe";

		init = <LCM_FUNC_UTIL LCM_UTIL_RESET 1 LCM_UTIL_RESET_HIGH>,
			<LCM_FUNC_UTIL LCM_UTIL_MDELAY 1 10>,
			<LCM_FUNC_UTIL LCM_UTIL_RESET 1 LCM_UTIL_RESET_LOW>,
			<LCM_FUNC_UTIL LCM_UTIL_MDELAY 1 10>,
			<LCM_FUNC_UTIL LCM_UTIL_RESET 1 LCM_UTIL_RESET_HIGH>,
			<LCM_FUNC_UTIL LCM_UTIL_MDELAY 1 120>,

			<LCM_FUNC_CMD LCM_UTIL_WRITE_CMD_V2 5 0xBF 3 0x91 0x61 0xF2>,
			<LCM_FUNC_CMD LCM_UTIL_WRITE_CMD_V2 4 0xB3 2 0x00 0x3D>,
			<LCM_FUNC_CMD LCM_UTIL_WRITE_CMD_V2 4 0xB4 2 0x00 0x34>,
			<LCM_FUNC_CMD LCM_UTIL_WRITE_CMD_V2 8 0xB8 6 0x00 0xD7 0x00 0x00  0xD3 0x00>,
			<LCM_FUNC_CMD LCM_UTIL_WRITE_CMD_V2 5 0xBA 3 0x3E 0x23 0x00>,
			<LCM_FUNC_CMD LCM_UTIL_WRITE_CMD_V2 3 0xC3 1 0x04>,
			<LCM_FUNC_CMD LCM_UTIL_WRITE_CMD_V2 4 0xC4 2 0x30 0x6A>,
			<LCM_FUNC_CMD LCM_UTIL_WRITE_CMD_V2 11 0xC7 9 0x00 0x01 0x31 0x0A 0x6A 0x2C 0x0F 0xA5 0xA5>,
			<LCM_FUNC_CMD LCM_UTIL_WRITE_CMD_V2 40 0xC8 38 0x7F 0x5F 0x4A 0x3B 0x33 0x25 0x2A 0x1D 0x35 0x36 0x2C 0x55 0x4A 0x54 0x4C 0x4D 0x47 0x2F 0x00 0x7F 0x61 0x4C 0x3E 0x38 0x28 0x2D 0x13 0x34 0x36 0x44 0x5D 0x4C 0x58 0x52 0x51 0x47 0x31 0x00>,

			<LCM_FUNC_CMD LCM_UTIL_WRITE_CMD_V2 18 0xD4 16 0x1F 0x1F 0x1F 0x03 0x01 0x05 0x07 0x09 0x0B 0x11 0x13 0x1F 0x1F 0x1F 0x1F 0x1F>,

			<LCM_FUNC_CMD LCM_UTIL_WRITE_CMD_V2 18 0xD5 16 0x1F 0x1F 0x1F 0x02 0x00 0x04 0x06 0x08 0x0A 0x10 0x12 0x1F 0x1F 0x1F 0x1F 0x1F>,

			<LCM_FUNC_CMD LCM_UTIL_WRITE_CMD_V2 18 0xD6 16 0x1F 0x1F 0x1F 0x10 0x12 0x04 0x0A 0x08 0x06 0x02 0x00 0x1F 0x1F 0x1F 0x1F 0x1F>,

			<LCM_FUNC_CMD LCM_UTIL_WRITE_CMD_V2 18 0xD7 16 0x1F 0x1F 0x1F 0x11 0x13 0x05 0x0B 0x09 0x07 0x03 0x01 0x1F 0x1F 0x1F 0x1F 0x1F>,

			<LCM_FUNC_CMD LCM_UTIL_WRITE_CMD_V2 22 0xD8 20 0x20 0x00 0x00 0x30 0x03 0x30 0x01 0x02 0x30 0x01 0x02 0x06 0x70 0x73 0x5D 0x72 0x06 0x38 0x70 0x08>,

			<LCM_FUNC_CMD LCM_UTIL_WRITE_CMD_V2 21 0xD9 19 0x00 0x0A 0x0A 0x88 0x00 0x00 0x06 0x7B 0x00 0x80 0x00 0x3B 0x33 0x1F 0x00 0x00 0x00 0x06 0x70>,

			<LCM_FUNC_CMD LCM_UTIL_WRITE_CMD_V2 3 0xBE 1 0x01>,

			<LCM_FUNC_CMD LCM_UTIL_WRITE_CMD_V2 3 0xC1 1 0x10>,

			<LCM_FUNC_CMD LCM_UTIL_WRITE_CMD_V2 12 0xCC 10 0x34 0x20 0x38 0x60 0x11 0x91 0x00 0x40 0x00 0x00>,

			<LCM_FUNC_CMD LCM_UTIL_WRITE_CMD_V2 3 0xBE 1 0x00 >,
			<LCM_FUNC_UTIL LCM_UTIL_MDELAY 1 50>, 
//SLP OUT
 			<LCM_FUNC_CMD LCM_UTIL_WRITE_CMD_V2 3 0x11  1  0x00>, 
 			<LCM_FUNC_UTIL LCM_UTIL_MDELAY 1 120 >,  
//DISP ON
 			<LCM_FUNC_CMD LCM_UTIL_WRITE_CMD_V2 3 0x29  1  0x00>;
		compare_id = <LCM_FUN_ID_SET LCM_GPIO_ID1_MODE 1 81>,
			<LCM_FUN_ID_SET LCM_GPIO_ID2_MODE 1 82>,
			<LCM_FUNC_UTIL LCM_UTIL_MDELAY 1 10>,
			<LCM_FUN_ID_CHECK 0 1 3>;

		suspend =<LCM_FUNC_CMD LCM_UTIL_WRITE_CMD_V2 3 0x28 0 0x00>,
     		      <LCM_FUNC_UTIL LCM_UTIL_MDELAY 1 10>,
		      <LCM_FUNC_CMD LCM_UTIL_WRITE_CMD_V2 3 0x10 0 0x00>,
     		      <LCM_FUNC_UTIL LCM_UTIL_MDELAY 1 120>;
	};
	/* LCM standardization end */
};

